## yocto/config/meta-astute/conf/layer.conf
```bitbake
# We have a conf and classes directory, add to BBPATH
BBPATH .= ":${LAYERDIR}"

# We have recipes-* directories, add to BBFILES
BBFILES += "${LAYERDIR}/recipes-*/*/*.bb \
            ${LAYERDIR}/recipes-*/*/*.bbappend"

BBFILE_COLLECTIONS += "meta-astute"
BBFILE_PATTERN_meta-astute = "^${LAYERDIR}/"
BBFILE_PRIORITY_meta-astute = "6"

LAYERDEPENDS_meta-astute = "core"
LAYERSERIES_COMPAT_meta-astute = "scarthgap"
```
